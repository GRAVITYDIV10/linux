/dts-v1/;

#include "mt7628a.dtsi"

/ {
	compatible = "xiaomi,4c", "ralink,mt7628a-soc";
	model = "Xiaomi4C";

	memory@0 {
		device_type = "memory";
		reg = <0x0 0x4000000>;
	};

	chosen {
		bootargs = "console=ttyS0,115200";
		stdout-path = &uart0;
	};
};
